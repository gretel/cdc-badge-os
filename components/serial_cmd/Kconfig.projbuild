## components/serial_cmd/Kconfig.projbuild
```kconfig
menu "Serial Command"

    config SECURE_SERIAL
        bool "Enable Secure Serial (require PIN authentication)"
        default y
        help
            When enabled, serial commands require PIN authentication.
            Only PING and AUTH commands work without login.
            Session times out after inactivity.

endmenu
```

## components/usb_badge/Kconfig.projbuild
```kconfig
menu "CDC Badge USB"

    config USB_EARLY_DEBUG
        bool "Start USB early for debugging"
        default n
        help
            When enabled, USB CDC starts immediately during boot for early debug output.
            This causes USB re-enumeration after modules are loaded, which may require
            unplugging and re-plugging the device on some hosts.

            When disabled (recommended for production), USB starts only after all
            modules are initialized, providing clean enumeration with all interfaces.

            Enable this only during development when you need boot-time debug logs.

endmenu
```

## components/wamr_runtime/Kconfig
```kconfig
menu "WAMR Runtime"

config WAMR_PSRAM_LINEAR_MEMORY_KB_DEFAULT
    int "Default WASM linear memory size per plugin (KB, in PSRAM)"
    range 16 1024
    default 128

config WAMR_PSRAM_OPERAND_STACK_KB
    int "WAMR operand+frame stack size per plugin (KB, in PSRAM)"
    range 4 128
    default 16

endmenu
```

## main/Kconfig.projbuild
```kconfig
menu "CDC Badge Features"

    config CDC_FEATURE_CA
        bool "Enable CA features"
        default y

    config CDC_FEATURE_TOTP
        bool "Enable TOTP"
        default y

    config CDC_FEATURE_FIDO2
        bool "Enable FIDO2 (includes SSH via ed25519-sk)"
        default y

endmenu
```

## sdkconfig.defaults
```kconfig
# Main task needs larger stack for TROPIC01 crypto operations
CONFIG_ESP_MAIN_TASK_STACK_SIZE=8192
CONFIG_FREERTOS_HZ=1000
CONFIG_ESPTOOLPY_FLASHSIZE_16MB=y
CONFIG_ESPTOOLPY_FLASHSIZE="16MB"
CONFIG_ESPTOOLPY_FLASHSIZE_DETECT=n
CONFIG_SPIRAM=y
CONFIG_SPIRAM_MODE_OCT=y
CONFIG_SPIRAM_SPEED_80M=y
CONFIG_SPIRAM_BOOT_INIT=y
CONFIG_SPIRAM_USE_MALLOC=y
CONFIG_SPIRAM_ALLOW_BSS_SEG_EXTERNAL_MEMORY=y
# TinyUSB mode: Completely disable USB-Serial-JTAG (mutually exclusive with TinyUSB)
CONFIG_USJ_ENABLE_USB_SERIAL_JTAG=n
CONFIG_ESP_CONSOLE_USB_SERIAL_JTAG_ENABLED=n
# No ROM console - we handle USB CDC ourselves via TinyUSB
CONFIG_ESP_CONSOLE_NONE=y
CONFIG_ESP_CONSOLE_SECONDARY_NONE=y
CONFIG_ESP_CONSOLE_UART_NONE=y
CONFIG_OPENTHREAD_ENABLED=n

# Bluetooth configuration (for BLE FIDO2)
CONFIG_BT_ENABLED=y
CONFIG_BT_BLUEDROID_ENABLED=y
CONFIG_BT_BLE_ENABLED=y
CONFIG_BT_GATTS_ENABLE=y
CONFIG_BT_BLE_42_FEATURES_SUPPORTED=y
CONFIG_BT_BLE_50_FEATURES_SUPPORTED=n
CONFIG_BTDM_CTRL_MODE_BLE_ONLY=y
CONFIG_BT_CTRL_BLE_MAX_ACT=6
CONFIG_BT_CTRL_BLE_MAX_ACT_EFF=6
CONFIG_BT_CTRL_BLE_STATIC_ACL_TX_BUF_NB=0
CONFIG_BT_CTRL_PINNED_TO_CORE=0
CONFIG_BT_CTRL_HCI_MODE_VHCI=y
CONFIG_BT_CTRL_LPCLK_SEL_MAIN_XTAL=y
# Disable classic BT (BLE only)
CONFIG_BT_CLASSIC_ENABLED=n
CONFIG_BT_A2DP_ENABLE=n
CONFIG_BT_SPP_ENABLED=n
CONFIG_BT_HFP_ENABLE=n
# Reduce BLE memory footprint
CONFIG_BT_BLE_DYNAMIC_ENV_MEMORY=y
CONFIG_BT_ALLOCATION_FROM_SPIRAM_FIRST=y
CONFIG_BT_BLE_ACL_BUF_COUNT=10
CONFIG_BT_ACL_CONNECTIONS=2
CONFIG_BT_BLE_ESTAB_LINK_CONN_TOUT=10
CONFIG_BT_GATT_MAX_SR_PROFILES=4
CONFIG_BT_GATT_MAX_SR_ATTRIBUTES=50
# Disable unused BT features
CONFIG_BT_GATTC_ENABLE=y
CONFIG_GATTC_ENABLE=y
CONFIG_BT_SMP_ENABLE=y
CONFIG_BT_BLE_SMP_ID_RESET_ENABLE=n
CONFIG_BT_STACK_NO_LOG=y

# Feature flags
CONFIG_CDC_FEATURE_CA=y
CONFIG_CDC_FEATURE_TOTP=y
CONFIG_CDC_FEATURE_FIDO2=y
CONFIG_CDC_FEATURE_FIDO2_BLE=y
CONFIG_CDC_FEATURE_USB_KEYBOARD=y
CONFIG_CDC_FEATURE_SECURE_SERIAL=y
CONFIG_EINK_SPI_MOSI=13
CONFIG_EINK_SPI_CLK=12
CONFIG_EINK_SPI_CS=41
CONFIG_EINK_DC=45
CONFIG_EINK_RST=46
CONFIG_EINK_BUSY=42
CONFIG_EINK_SPI_MISO=11
CONFIG_EINK_SPI_CS2=-1
# WiFi configuration
CONFIG_ESP_WIFI_ENABLED=y
CONFIG_ESP_WIFI_STATIC_RX_BUFFER_NUM=10
CONFIG_ESP_WIFI_DYNAMIC_RX_BUFFER_NUM=32
CONFIG_ESP_WIFI_DYNAMIC_TX_BUFFER_NUM=32
CONFIG_ESP_WIFI_TX_BA_WIN=6
CONFIG_ESP_WIFI_RX_BA_WIN=6
CONFIG_ESP_WIFI_IRAM_OPT=y
CONFIG_ESP_WIFI_RX_IRAM_OPT=y

# WiFi/BLE Coexistence (ESP32-S3)
CONFIG_ESP_COEX_SW_COEXIST_ENABLE=y
CONFIG_ESP_COEX_EXTERNAL_COEXIST_ENABLE=n
# Pin WiFi to Core 1 (BT is on Core 0) for better coexistence
CONFIG_ESP_WIFI_TASK_CORE_ID=1
CONFIG_ESP_WIFI_TASK_PINNED_TO_CORE_1=y
CONFIG_ESP_WIFI_TASK_PINNED_TO_CORE_0=n
# Power save settings that help coexistence
CONFIG_ESP_WIFI_SLP_IRAM_OPT=n

# Note: MBEDTLS_X509_CRT_WRITE_C enabled by default in mbedTLS 3.x
```
